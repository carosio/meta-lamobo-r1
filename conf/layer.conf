## conf/layer.conf
```bitbake
# We have a conf and classes directory, add to BBPATH
BBPATH .= ":${LAYERDIR}"

# We have recipes-* directories, add to BBFILES
BBFILES += "${LAYERDIR}/recipes-*/*/*.bb \
            ${LAYERDIR}/recipes-*/*/*.bbappend"

BBFILE_COLLECTIONS += "lamobo-r1"
BBFILE_PATTERN_lamobo-r1 = "^${LAYERDIR}/"
BBFILE_PRIORITY_lamobo-r1 = "12"
LAYERVERSION_lamobo-r1 = "1"
```

## conf/machine/sun7i-a20-lamobo-r1.conf
```bitbake
#@TYPE: Machine
#@NAME: Lamobo-R1
#@DESCRIPTION: Machine configuration for the lamobo-r1, based on allwinner A20 CPU http://bananapi.org/

# Only has DVI connector for external screen
# GUI_MACHINE_CLASS = "bigscreen"

DEFAULTTUNE = "cortexa7hf-neon-vfpv4"

require conf/machine/include/tune-cortexa7.inc
require conf/machine/include/soc-family.inc
require conf/machine/include/sunxi.inc
# require conf/machine/include/sunxi-mali.inc

PREFERRED_PROVIDER_virtual/xserver ?= "xserver-xorg"
PREFERRED_PROVIDER_virtual/libgl ?= "mesa"
PREFERRED_PROVIDER_virtual/libgles1 ?= "mesa"
PREFERRED_PROVIDER_virtual/libgles2 ?= "mesa"

SOC_FAMILY = "sunxi:sun7i"

MACHINE_EXTRA_RRECOMMENDS = " kernel-modules kernel-devicetree"

EXTRA_IMAGEDEPENDS += "u-boot"

KERNEL_DEVICETREE = "sun7i-a20-lamobo-r1.dtb"

PREFERRED_VERSION_u-boot ?= "v2016.01%"
UBOOT_MACHINE = "Lamobo_R1_config"
UBOOT_ENTRYPOINT = "0x40008000"
UBOOT_LOADADDRESS = "0x40008000"

KERNEL_EXTRA_ARGS += "LOADADDR=${UBOOT_ENTRYPOINT}"

SERIAL_CONSOLE = "115200 ttyS0"

CORE_IMAGE_EXTRA_INSTALL = "swconfig linux-firmware-rtl8192cu iw qemu"

MACHINE_FEATURES = "screen apm usbgadget usbhost vfat"
```
